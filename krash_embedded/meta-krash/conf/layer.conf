## krash_embedded/meta-krash/conf/layer.conf
```bitbake
# We have a conf and classes directory, add to BBPATH
BBPATH .= ":${LAYERDIR}"

# We have recipes-* directories, add to BBFILES
BBFILES += "${LAYERDIR}/recipes-kernel/krash.bb \
            ${LAYERDIR}/recipes-core/images/core-image-full-cmdline.bbappend"

BBFILE_COLLECTIONS += "recipes-krash"
BBFILE_PATTERN_recipes-krash = "^${LAYERDIR}/"
BBFILE_PRIORITY_recipes-krash = "6"

LAYERDEPENDS_recipes-krash = "meta-qemu-x86_64-bsp-custom-kernel"
# LAYERDEPENDS_recipes-krash = "meta-qemu-arm64-bsp-custom-kernel"
LAYERSERIES_COMPAT_recipes-krash = "kirkstone"
```

## krash_embedded/meta-ucrash/conf/layer.conf
```bitbake
# We have a conf and classes directory, add to BBPATH
BBPATH .= ":${LAYERDIR}"

# We have recipes-* directories, add to BBFILES
BBFILES += "${LAYERDIR}/ucrash/ucrash.bb \
            ${LAYERDIR}/recipes-core/images/core-image-full-cmdline.bbappend"

BBFILE_COLLECTIONS += "recipes-ucrash"
BBFILE_PATTERN_recipes-ucrash = "^${LAYERDIR}/"
BBFILE_PRIORITY_recipes-ucrash = "6"

LAYERDEPENDS_recipes-ucrash = "meta-arm recipes-krash"
LAYERSERIES_COMPAT_recipes-ucrash = "kirkstone"
```

## madsim_embedded/conf/bblayers.conf
```bitbake
# POKY_BBLAYERS_CONF_VERSION is increased each time build/conf/bblayers.conf
# changes incompatibly
POKY_BBLAYERS_CONF_VERSION = "2"

BBPATH = "${TOPDIR}"
BBFILES ?= ""

BBLAYERS ?= " \
  /home/htfones/GIT/yocto/poky/meta \
  /home/htfones/GIT/yocto/poky/meta-poky \
  /home/htfones/GIT/yocto/poky/meta-arm/meta-arm-toolchain \
  /home/htfones/GIT/yocto/poky/meta-arm/meta-arm \
  /home/htfones/GIT/yocto/poky/meta-yocto-bsp \
  /home/htfones/GIT/yocto/poky/meta-openembedded/meta-oe \
  /home/htfones/GIT/yocto/poky/meta-qemu-arm64-bsp \
  /home/htfones/GIT/yocto/poky/meta-qemu-arm64-bsp/meta-qemu-arm64-bsp-custom-dts \
  /home/htfones/GIT/yocto/poky/meta-qemu-arm64-bsp/meta-qemu-arm64-bsp-custom-kernel \
  /home/htfones/GIT/yocto/poky/meta-custom-mods \
  /home/htfones/GIT/yocto/poky/meta-custom-mods/meta-madsimko \
  /home/htfones/GIT/yocto/poky/meta-custom-apps/meta-madsimui \
  /home/htfones/GIT/yocto/poky/meta-custom-scripts/meta-madsimsh \
  "
```

## madsim_embedded/meta-custom-apps/conf/layer.conf
```bitbake
# We have a conf and classes directory, add to BBPATH
BBPATH .= ":${LAYERDIR}"

BBFILES += ""

BBFILE_COLLECTIONS += "meta-custom-apps"
BBFILE_PATTERN_meta-custom-apps = "^${LAYERDIR}/"
BBFILE_PRIORITY_meta-custom-apps = "6"

LAYERDEPENDS_meta-custom-apps = "meta-arm"
LAYERSERIES_COMPAT_meta-custom-apps = "kirkstone"
```

## madsim_embedded/meta-custom-mods/conf/layer.conf
```bitbake
# We have a conf and classes directory, add to BBPATH
BBPATH .= ":${LAYERDIR}"

BBFILES += ""

BBFILE_COLLECTIONS += "meta-custom-mods"
BBFILE_PATTERN_meta-custom-mods = "^${LAYERDIR}/"
BBFILE_PRIORITY_meta-custom-mods = "6"

LAYERDEPENDS_meta-custom-mods = "meta-qemu-arm64-bsp-custom-kernel"
LAYERSERIES_COMPAT_meta-custom-mods = "kirkstone"
###LAYERSERIES_COMPAT_meta-custom-mods = "scarthgap"
```

## madsim_embedded/meta-custom-mods/meta-madsimko/conf/layer.conf
```bitbake
# We have a conf and classes directory, add to BBPATH
BBPATH .= ":${LAYERDIR}"

# We have recipes-* directories, add to BBFILES
BBFILES += "${LAYERDIR}/recipes-*/madsimko.bb \
            ${LAYERDIR}/recipes-extended/images/core-image-full-cmdline.bbappend"

BBFILE_COLLECTIONS += "meta-madsimko"
BBFILE_PATTERN_meta-madsimko = "^${LAYERDIR}/"
BBFILE_PRIORITY_meta-madsimko = "7"

LAYERDEPENDS_meta-madsimko = "meta-qemu-arm64-bsp-custom-kernel"
###LAYERDEPENDS_meta-madsimko = "meta-beagleplay-bsp-custom-kernel"
LAYERSERIES_COMPAT_meta-madsimko = "kirkstone"
###LAYERSERIES_COMPAT_meta-madsimko = "scarthgap"
```

## madsim_embedded/meta-custom-scripts/meta-madsimsh/conf/layer.conf
```bitbake
# We have a conf and classes directory, add to BBPATH
BBPATH .= ":${LAYERDIR}"

# We have recipes-* directories, add to BBFILES 
BBFILES +=  "${LAYERDIR}/madsim-scripts/madsimsh.bb \
             ${LAYERDIR}/recipes-extended/images/core-image-full-cmdline.bbappend"
BBFILE_COLLECTIONS += "meta-madsimsh"

BBFILE_PATTERN_meta-madsimsh = "^${LAYERDIR}/madsim-scripts"

BBFILE_PRIORITY_meta-madsimsh = "7"

LAYERDEPENDS_meta-madsimsh = "meta-madsimui"

###LAYERSERIES_COMPAT_meta-madsimsh = "scarthgap"
LAYERSERIES_COMPAT_meta-madsimsh = "kirkstone"
```

## madsim_embedded/meta-qemu-arm64-bsp/conf/layer.conf
```bitbake
# We have a conf and classes directory, add to BBPATH
BBPATH .= ":${LAYERDIR}"

BBFILES += ""

BBFILE_COLLECTIONS += "meta-qemu-arm64-bsp"
BBFILE_PATTERN_meta-qemu-arm64-bsp = "^${LAYERDIR}/"
BBFILE_PRIORITY_meta-qemu-arm64-bsp = "6"
LAYERVERSION_meta-qemu-arm64-bsp = "4"
LAYERSERIES_COMPAT_meta-qemu-arm64-bsp = "kirkstone"

LAYERDEPENDS_meta-qemu-arm64-bsp = " meta-arm"
```

## madsim_embedded/meta-qemu-arm64-bsp/meta-qemu-arm64-bsp-custom-dts/conf/layer.conf
```bitbake
# We have a conf and classes directory, add to BBPATH
BBPATH .= ":${LAYERDIR}"

# We have recipes-* directories, add to BBFILES
BBFILES += "${LAYERDIR}/recipes-*/*/*.bb \
            ${LAYERDIR}/recipes-*/*/*.bbappend"

BBFILE_COLLECTIONS += "meta-qemu-arm64-bsp-custom-dts"
BBFILE_PATTERN_meta-qemu-arm64-bsp-custom-dts = "^${LAYERDIR}/"
BBFILE_PRIORITY_meta-qemu-arm64-bsp-custom-dts = "7"

LAYERDEPENDS_meta-qemu-arm64-bsp-custom-dts = "meta-qemu-arm64-bsp"
LAYERSERIES_COMPAT_meta-qemu-arm64-bsp-custom-dts = "kirkstone"
```
